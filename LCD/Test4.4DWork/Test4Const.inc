// File generated 09-Mar-16 3:33:40 PM
// Warning! This is a generated file, any manual changes will be
// lost during the next generation.

// object indexes for Inputs, Image Addresses + Input Array
#CONST
    iAnibutton1
    iWinbutton1
    iAnibutton1H      0x0000
    iAnibutton1L      0x0000
    iWinbutton1H      0x0000
    iWinbutton1L      0x0000
    iCustomdigits1H   0x0000
    iCustomdigits1L   0x3E00
    iiCustomdigits1H  0x0000
    iiCustomdigits1L  0x4200
    iUserled1H        0x0000
    iUserled1L        0x4C00
    Inputs          2
#END

#DATA
    word InputX1 3, 7
    word InputX2 36, 118
    word InputY1 83, 87
    word InputY2 116, 123
    word InputH 0x0000, 0x0000
    word InputL 0x0000, 0x0000
#END

var curInput ;
